## Kconfig
```kconfig
# Copyright (c) 2026 Greg Grunschel
# SPDX-License-Identifier: MIT

DT_COMPAT_ZMK_BEHAVIOR_MOUSE_SPEED := zmk,behavior-mouse-speed

config ZMK_BEHAVIOR_MOUSE_SPEED
    bool
    default $(dt_compat_enabled,$(DT_COMPAT_ZMK_BEHAVIOR_MOUSE_SPEED))

DT_COMPAT_ZMK_INPUT_PROCESSOR_MOUSE_SPEED := zmk,input-processor-mouse-speed

config ZMK_INPUT_PROCESSOR_MOUSE_SPEED
    bool
    default $(dt_compat_enabled,$(DT_COMPAT_ZMK_INPUT_PROCESSOR_MOUSE_SPEED))
```

## dts/bindings/behaviors/zmk,behavior-mouse-speed.yaml
```yaml
# Copyright (c) 2026 Greg Grunschel
# SPDX-License-Identifier: MIT

description: Step the saved cursor speed for the selected host

compatible: "zmk,behavior-mouse-speed"

include: one_param.yaml
```

## dts/bindings/input_processors/zmk,input-processor-mouse-speed.yaml
```yaml
# Copyright (c) 2026 Greg Grunschel
# SPDX-License-Identifier: MIT

description: Scale hat cursor counts by the saved per-host speed

compatible: "zmk,input-processor-mouse-speed"

include: ip_zero_param.yaml
```
